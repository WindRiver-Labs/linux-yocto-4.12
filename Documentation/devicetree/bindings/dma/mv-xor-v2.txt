## Documentation/devicetree/bindings/dma/mv-xor-v2.txt
```
* Marvell XOR v2 engines

Required properties:
- compatible: one of the following values:
    "marvell,armada-7k-xor"
    "marvell,xor-v2"
- reg: Should contain registers location and length (two sets)
    the first set is the DMA registers
    the second set is the global registers
- dma-bus-width: DMA address bus width
- msi-parent: Phandle to the MSI-capable interrupt controller used for
  interrupts.
- clocks: One ore more clock gating clocks to be used to enable DMA engine
  unit in the SoC.

Optional properties:
- clocks: Optional reference to the clock used by the XOR engine.

Example:

	xor0@400000 {
		compatible = "marvell,xor-v2";
		reg = <0x400000 0x1000>,
		      <0x410000 0x1000>;
		msi-parent = <&gic_v2m0>;
		clocks = <&gateclk 14>;
		dma-coherent;
		dma-width = <40>;
	};
```

## drivers/edac/Kconfig.rej
```kconfig
diff a/drivers/edac/Kconfig b/drivers/edac/Kconfig	(rejected hunks)
@@ -382,6 +382,30 @@ config EDAC_OCTEON_PCI
	  Support for error detection and correction on the
	  Cavium Octeon family of SOCs.

+config EDAC_AXXIA_SYSMEM
+	tristate "AXXIA EDAC SysMem Controller"
+	help
+	  Support for System Memory Denali controller error
+	  detection on the AXXIA AXM55xx devices. This enables
+	  the System Memory error detection. System Memory error
+	  detection is interrupt driven.
+
+config EDAC_AXXIA_L3
+	tristate "AXXIA EDAC L3 Controller"
+	help
+	  Support for the eight L3 caches error detection
+	  on the AXXIA AXM55xx devices. This enables the
+	  L3 cache error detection. L3 cache error detection
+	  uses polling mechanism.
+
+config EDAC_AXXIA_L2_CPU
+	tristate "AXXIA EDAC L2/CPU Controller"
+	help
+	  Support for L2 cache and A15 CPU error detection
+	  on AXXIA AXM55xx devices. This enables the L2
+	  cache and A15 CPU error detction. L2 cache and A15
+	  CPU error detection uses polling mechanism.
+
 config EDAC_ALTERA
	bool "Altera SOCFPGA ECC"
	depends on EDAC_MM_EDAC=y && ARCH_SOCFPGA
```

## drivers/soc/imx/Kconfig
```kconfig
menu "i.MX SoC drivers"

config IMX7_PM_DOMAINS
	bool "i.MX7 PM domains"
	depends on SOC_IMX7D || (COMPILE_TEST && OF)
	depends on PM
	select PM_GENERIC_DOMAINS
	default y if SOC_IMX7D

config ARCH_FSL_IMX8QM
	bool "i.MX8QM"
	select HAVE_IMX_MU
	select HAVE_IMX_RPMSG

config ARCH_FSL_IMX8QXP
	bool "i.MX8QXP"
	select HAVE_IMX_MU
	select HAVE_IMX_RPMSG

config ARCH_FSL_IMX8MQ
	bool "i.MX8MQ"
	select HAVE_IMX_MU
	select HAVE_IMX_RPMSG

config HAVE_IMX_MU
	bool

config HAVE_IMX_RPMSG
	select RPMSG_VIRTIO
	select RPMSG
	bool

endmenu
```
